## source/firmware/sdkconfig.defaults
```kconfig
# Target
CONFIG_IDF_TARGET="esp32c3"

# Flash 8MB
CONFIG_ESPTOOLPY_FLASHSIZE_8MB=y
# Offline merge-bin requires a concrete flash size, not detect.
CONFIG_ESPTOOLPY_HEADER_FLASHSIZE_UPDATE=n
CONFIG_PARTITION_TABLE_CUSTOM=y
CONFIG_PARTITION_TABLE_CUSTOM_FILENAME="partitions.csv"

# Console: USB-Serial-JTAG (GPIO 18/19)
CONFIG_ESP_CONSOLE_USB_SERIAL_JTAG=y
CONFIG_ESP_CONSOLE_SECONDARY_NONE=y

# FreeRTOS & System
CONFIG_FREERTOS_HZ=1000
CONFIG_FREERTOS_USE_TRACE_FACILITY=y
CONFIG_ESP_SYSTEM_EVENT_TASK_STACK_SIZE=4096

# LVGL 9
CONFIG_LV_COLOR_DEPTH_16=y
CONFIG_LV_FONT_MONTSERRAT_14=y
CONFIG_LV_FONT_MONTSERRAT_20=y
# 首页大时钟(48px 数字)专用。字模约 100KB,全部落在 flash 的 .rodata 并经
# MMU 直接映射,不占 SRAM。C3 无 PSRAM,任何"把字模读进内存"的做法都不可取。
CONFIG_LV_FONT_MONTSERRAT_32=y
CONFIG_LV_FONT_MONTSERRAT_48=y
CONFIG_LV_FONT_UNSCII_8=y
CONFIG_LV_FONT_UNSCII_16=y
# Use the shared ESP-IDF heap for LVGL. Screens are destroyed during app
# transitions, so their memory is returned to the same heap that Xiaozhi uses
# for TLS and Opus instead of permanently reserving a 24 KB private pool.
CONFIG_LV_USE_CLIB_MALLOC=y
CONFIG_LV_USE_FS_MEMFS=y
CONFIG_LV_FS_MEMFS_LETTER=77
CONFIG_LV_USE_TJPGD=y
CONFIG_LV_USE_SNAPSHOT=y
CONFIG_LV_BUILD_EXAMPLES=n
CONFIG_LV_BUILD_DEMOS=n

# Audio Decoders (esp_audio_codec)
CONFIG_AUDIO_DECODER_MP3_SUPPORT=y

# TLS & Certificates
CONFIG_MBEDTLS_CERTIFICATE_BUNDLE=y
CONFIG_MBEDTLS_CERTIFICATE_BUNDLE_DEFAULT_FULL=y
CONFIG_MBEDTLS_DYNAMIC_BUFFER=y
CONFIG_MBEDTLS_SSL_KEEP_PEER_CERTIFICATE=n
CONFIG_MBEDTLS_ASYMMETRIC_CONTENT_LEN=y
CONFIG_MBEDTLS_SSL_IN_CONTENT_LEN=4096
CONFIG_MBEDTLS_SSL_OUT_CONTENT_LEN=2048
CONFIG_ESP_WIFI_DYNAMIC_RX_MGMT_BUFFER=y

# Web server & HTTP
CONFIG_HTTPD_MAX_REQ_HDR_LEN=1024
CONFIG_HTTPD_MAX_URI_LEN=256

# Wi-Fi Memory Tuning
CONFIG_ESP_WIFI_STATIC_RX_BUFFER_NUM=3
CONFIG_ESP_WIFI_DYNAMIC_RX_BUFFER_NUM=8
CONFIG_ESP_WIFI_DYNAMIC_TX_BUFFER_NUM=8
CONFIG_ESP_WIFI_RX_BA_WIN=4
CONFIG_ESP_WIFI_TX_BA_WIN=4
CONFIG_ESP_WIFI_MGMT_SBUF_NUM=6
CONFIG_ESP_WIFI_RX_MGMT_BUF_NUM_DEF=3
CONFIG_ESP_WIFI_ENABLE_WPA3_SAE=n
CONFIG_ESP_WIFI_IRAM_OPT=n
CONFIG_ESP_WIFI_RX_IRAM_OPT=n
CONFIG_LWIP_TCPIP_RECVMBOX_SIZE=16
CONFIG_FREERTOS_IDLE_TASK_STACKSIZE=768

# Bluetooth LE (NimBLE)
CONFIG_BT_ENABLED=y
CONFIG_BT_NIMBLE_ENABLED=y
CONFIG_BT_NIMBLE_ROLE_PERIPHERAL=y
CONFIG_BT_NIMBLE_ROLE_CENTRAL=y
CONFIG_BT_NIMBLE_GATT_CLIENT=y
CONFIG_BT_NIMBLE_GATT_MAX_PROCS=2
CONFIG_BT_NIMBLE_ATT_MAX_PREP_ENTRIES=8
CONFIG_BT_NIMBLE_MSYS_2_BLOCK_COUNT=16
CONFIG_BT_NIMBLE_TRANSPORT_ACL_FROM_LL_COUNT=16
CONFIG_BT_NIMBLE_TRANSPORT_EVT_COUNT=15
CONFIG_BT_NIMBLE_TRANSPORT_EVT_DISCARD_COUNT=4
CONFIG_BT_NIMBLE_ROLE_OBSERVER=n
CONFIG_BT_NIMBLE_MAX_CONNECTIONS=1
CONFIG_BT_NIMBLE_HOST_BASED_PRIVACY=n
CONFIG_BT_NIMBLE_UTIL_API=y
CONFIG_BT_NIMBLE_SM_LEGACY=n
CONFIG_BT_NIMBLE_SM_SC=y
CONFIG_BT_NIMBLE_NVS_PERSIST=y
CONFIG_BT_NIMBLE_ATT_PREFERRED_MTU=517

# main 任务栈:Home 应用在主任务里走 LVGL TJPEG decoder_info(文件源),
# 其栈上 workb[TJPGD_WORKBUFF_SIZE] ~3.1KB,3584 必爆(2026-09-13 真机
# Stack protection fault 崩溃循环,addr2line 定位 lv_tjpgd.c:82)。
CONFIG_ESP_MAIN_TASK_STACK_SIZE=8192
```
